#include <mega128.h>
#include <glcd.h>
#include <font5x7.h>
#include <delay.h>
#include <stdio.h>
#include <math.h>


#define BT3_ZERO        PINB.0
#define BT1_MODE        PINB.2
#define BT2_EDIT        PINB.3

#define BTN_PRESSED     0
#define BT2_HOLD_MS     1000
#define DEBOUNCE_TICKS  4
#define POLL_MS         5

#define DISPLAY_SOLAR   0
#define DISPLAY_LUNAR   1

#define EDIT_HOUR       0
#define EDIT_MINUTE     1
#define EDIT_DAY        2
#define EDIT_MONTH      3
#define EDIT_YEAR       4

#define PI_VALUE        3.14159265358979323846
#define TIME_ZONE       7.0

typedef struct {
    unsigned int year;
    unsigned char month;
    unsigned char day;
    unsigned char valid;
} SolarDate;

typedef struct {
    unsigned char day;
    unsigned char month;
    unsigned int year;
    unsigned char leap;
    unsigned char valid;
} LunarDate;


typedef struct {
    unsigned int solar_year;
    unsigned char solar_month;
    unsigned char solar_day;
    unsigned int lunar_year;
    unsigned char lunar_month;
    unsigned char leap;
    unsigned char month_days;
} LunarMonthStart;

/*
   Bang moc dau thang am sinh tu thuat toan Ho Ngoc Duc, timezone UTC+7.
   Pham vi tra cuu: 01/01/2000 den 31/12/2099.
*/
flash LunarMonthStart lunar_table[] = {
    {1999, 12,  8, 1999, 11, 0, 30},
    {2000,  1,  7, 1999, 12, 0, 29},
    {2000,  2,  5, 2000,  1, 0, 30},
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    {2099, 12, 12, 2099, 11, 0, 29}
};

#define LUNAR_TABLE_SIZE (sizeof(lunar_table) / sizeof(lunar_table[0]))

volatile unsigned int tick_1s = 0;
volatile unsigned char bt1_event = 0;
volatile unsigned char bt2_short_event = 0;
volatile unsigned char bt2_hold_event = 0;
volatile unsigned char bt3_event = 0;
volatile unsigned char keypad_event = 0;
volatile unsigned char keypad_event_value = 0;

unsigned char hour = 14;
unsigned char minute = 25;
unsigned char second = 0;
unsigned char day = 26;
unsigned char month = 5;
unsigned int year = 2026;

unsigned char display_mode = DISPLAY_SOLAR;
unsigned char edit_mode = 0;
unsigned char edit_field = EDIT_HOUR;
unsigned char edit_digits[4];
unsigned char edit_digit_count = 0;
unsigned char need_redraw = 1;
unsigned char full_redraw = 1;

unsigned char keypad_value[3][3] = {
    {1, 2, 3},
    {4, 5, 6},
    {7, 8, 9}
};

void timer0_poll_keys(void);

interrupt [TIM1_COMPA] void timer1_compa_isr(void)
{
    tick_1s++;
}

interrupt [TIM0_COMP] void timer0_comp_isr(void)
{
    timer0_poll_keys();
}

unsigned char is_leap_year(unsigned int y)
{
    if ((y % 400) == 0) return 1;
    if ((y % 100) == 0) return 0;
    return ((y % 4) == 0);
}

unsigned char days_in_month(unsigned char m, unsigned int y)
{
    switch (m) {
    case 1:
    case 3:
    case 5:
    case 7:
    case 8:
    case 10:
    case 12:
        return 31;
    case 4:
    case 6:
    case 9:
    case 11:
        return 30;
    case 2:
        return is_leap_year(y) ? 29 : 28;
    default:
        return 31;
    }
}

unsigned char valid_date(unsigned char d, unsigned char m, unsigned int y)
{
    if (y < 2000 || y > 2099) return 0;
    if (m < 1 || m > 12) return 0;
    if (d < 1 || d > days_in_month(m, y)) return 0;
    return 1;
}

long date_to_days(unsigned int y, unsigned char m, unsigned char d)
{
    long total = 0;
    unsigned int yy;
    unsigned char mm;

    if (y >= 2000) {
        for (yy = 2000; yy < y; yy++) {
            total += is_leap_year(yy) ? 366 : 365;
        }
    } else {
        for (yy = y; yy < 2000; yy++) {
            total -= is_leap_year(yy) ? 366 : 365;
        }
    }

    for (mm = 1; mm < m; mm++) {
        total += days_in_month(mm, y);
    }

    total += d - 1;
    return total;
}

void increase_one_second(void)
{
    second++;
    if (second < 60) return;
    second = 0;

    minute++;
    if (minute < 60) return;
    minute = 0;

    hour++;
    if (hour < 24) return;
    hour = 0;

    day++;
    if (day <= days_in_month(month, year)) return;
    day = 1;

    month++;
    if (month <= 12) return;
    month = 1;
    year++;
}

LunarDate get_lunar_date(unsigned int sy, unsigned char sm, unsigned char sd)
{
    LunarDate out;
    long current;
    long start;
    unsigned int i;

    out.valid = 0;
    out.day = 0;
    out.month = 0;
    out.year = 0;
    out.leap = 0;

    current = date_to_days(sy, sm, sd);

    for (i = 0; i < LUNAR_TABLE_SIZE; i++) {
        start = date_to_days(lunar_table[i].solar_year,
                             lunar_table[i].solar_month,
                             lunar_table[i].solar_day);

        if (current >= start &&
            current < (start + lunar_table[i].month_days)) {
            out.valid = 1;
            out.day = (unsigned char)(current - start + 1);
            out.month = lunar_table[i].lunar_month;
            out.year = lunar_table[i].lunar_year;
            out.leap = lunar_table[i].leap;
            return out;
        }
    }

    return out;
}

void clear_rect_pixels(unsigned char left, unsigned char top,
                       unsigned char right, unsigned char bottom)
{
    unsigned char x;
    unsigned char y;

    for (x = left; x <= right; x++) {
        for (y = top; y <= bottom; y++) {
            glcd_putpixel(x, y, 0);
        }
    }
}

void draw_screen(void)
{
    char line[22];
    char input[7];
    LunarDate lunar;

    if (full_redraw) {
        glcd_clear();
        full_redraw = 0;
    }

    clear_rect_pixels(0, 0, 83, 7);
    glcd_setcolor(1);
    if (edit_mode) {
        glcd_outtextxy(0, 0, "CHE DO SUA");
    } else {
        glcd_outtextxy(0, 0, "LICH VAN NIEN");
    }

    clear_rect_pixels(0, 10, 83, 17);
    glcd_setcolor(1);
    sprintf(line, "TIME %02u:%02u:%02u", hour, minute, second);
    glcd_outtextxy(0, 10, line);

    clear_rect_pixels(0, 20, 83, 37);
    glcd_setcolor(1);
    if (display_mode == DISPLAY_SOLAR) {
        sprintf(line, "DL %02u/%02u/%04u", day, month, year);
        glcd_outtextxy(0, 20, line);
        glcd_outtextxy(0, 30, "MODE DUONG");
    } else {
        lunar = get_lunar_date(year, month, day);
        if (lunar.valid) {
            sprintf(line, "AL %02u/%02u/%04u", lunar.day, lunar.month, lunar.year);
            glcd_outtextxy(0, 20, line);
            if (lunar.leap) {
                glcd_outtextxy(0, 30, "MODE AM N");
            } else {
                glcd_outtextxy(0, 30, "MODE AM");
            }
        } else {
            glcd_outtextxy(0, 20, "AL NO DATA");
            glcd_outtextxy(0, 30, "THEM BANG AM");
        }
    }

    clear_rect_pixels(0, 40, 83, 47);
    glcd_setcolor(1);
    if (edit_mode) {
        switch (edit_field) {
        case EDIT_HOUR:
            glcd_outtextxy(0, 40, "SUA GIO");
            break;
        case EDIT_MINUTE:
            glcd_outtextxy(0, 40, "SUA PHUT");
            break;
        case EDIT_DAY:
            glcd_outtextxy(0, 40, "SUA NGAY");
            break;
        case EDIT_MONTH:
            glcd_outtextxy(0, 40, "SUA THANG");
            break;
        default:
            glcd_outtextxy(0, 40, "SUA NAM");
            break;
        }

        input[0] = 'I';
        input[1] = ':';
        input[2] = (edit_digit_count > 0) ? (edit_digits[0] + '0') : '_';
        input[3] = (edit_digit_count > 1) ? (edit_digits[1] + '0') : '_';
        input[4] = 0;

        if (edit_field == EDIT_YEAR) {
            input[2] = (edit_digit_count > 0) ? (edit_digits[0] + '0') : '_';
            input[3] = (edit_digit_count > 1) ? (edit_digits[1] + '0') : '_';
            input[4] = (edit_digit_count > 2) ? (edit_digits[2] + '0') : '_';
            input[5] = (edit_digit_count > 3) ? (edit_digits[3] + '0') : '_';
            input[6] = 0;
        }

        glcd_outtextxy(54, 40, input);
    } else {
        glcd_outtextxy(0, 40, "BT2 GIU: SUA");
    }
}

void clear_edit_input(void)
{
    edit_digit_count = 0;
    edit_digits[0] = 0;
    edit_digits[1] = 0;
    edit_digits[2] = 0;
    edit_digits[3] = 0;
}

void next_edit_field(void)
{
    clear_edit_input();
    edit_field++;
    if (edit_field > EDIT_YEAR) edit_field = EDIT_HOUR;
}

void apply_edit_value(void)
{
    unsigned int value = 0;
    unsigned char i;
    unsigned char new_day = day;
    unsigned char new_month = month;
    unsigned int new_year = year;

    for (i = 0; i < edit_digit_count; i++) {
        value = value * 10 + edit_digits[i];
    }

    if (edit_field == EDIT_HOUR && edit_digit_count == 2 && value < 24) {
        hour = (unsigned char)value;
        second = 0;
    } else if (edit_field == EDIT_MINUTE && edit_digit_count == 2 && value < 60) {
        minute = (unsigned char)value;
        second = 0;
    } else if (edit_field == EDIT_DAY && edit_digit_count == 2) {
        new_day = (unsigned char)value;
        if (valid_date(new_day, month, year)) day = new_day;
    } else if (edit_field == EDIT_MONTH && edit_digit_count == 2) {
        new_month = (unsigned char)value;
        if (valid_date(day, new_month, year)) month = new_month;
    } else if (edit_field == EDIT_YEAR && edit_digit_count == 4) {
        new_year = value;
        if (valid_date(day, month, new_year)) year = new_year;
    }
}

void handle_digit(unsigned char digit)
{
    unsigned char max_digits;

    if (!edit_mode) return;

    max_digits = (edit_field == EDIT_YEAR) ? 4 : 2;
    if (edit_digit_count >= max_digits) {
        clear_edit_input();
    }

    edit_digits[edit_digit_count] = digit;
    edit_digit_count++;

    if (edit_digit_count == max_digits) {
        apply_edit_value();
    }

    need_redraw = 1;
}

void keypad_rows_idle(void)
{
    PORTC = 0x70;
    PORTE = 0x03;
    PORTD = 0x81;
}

unsigned char scan_keypad_raw(void)
{
    unsigned char r;

    for (r = 0; r < 3; r++) {
        if (r == 0) {
            PORTC = 0x30;
            PORTE = 0x03;
            PORTD = 0x81;
        }

        if (r == 1) {
            PORTC = 0x70;
            PORTE = 0x01;
            PORTD = 0x81;
        }

        if (r == 2) {
            PORTC = 0x70;
            PORTE = 0x03;
            PORTD = 0x80;
        }

        delay_us(10);

        if ((PINC & 0x10) == 0) {
            keypad_rows_idle();
            return keypad_value[r][0];
        }

        if ((PINC & 0x20) == 0) {
            keypad_rows_idle();
            return keypad_value[r][1];
        }

        if ((PINE & 0x01) == 0) {
            keypad_rows_idle();
            return keypad_value[r][2];
        }
    }

    keypad_rows_idle();
    return 0;
}

unsigned char debounce_state(unsigned char raw,
                             unsigned char *stable,
                             unsigned char *last_raw,
                             unsigned char *count)
{
    if (raw == *last_raw) {
        if (*count < DEBOUNCE_TICKS) (*count)++;
    } else {
        *last_raw = raw;
        *count = 0;
    }

    if (*count >= DEBOUNCE_TICKS && *stable != raw) {
        *stable = raw;
        if (raw != 0) {
            return 1;
        }
    }

    return 0;
}

void timer0_poll_keys(void)
{
    static unsigned char bt1_stable = 0;
    static unsigned char bt1_last = 0;
    static unsigned char bt1_count = 0;
    static unsigned char bt2_stable = 0;
    static unsigned char bt2_last = 0;
    static unsigned char bt2_count = 0;
    static unsigned char bt3_stable = 0;
    static unsigned char bt3_last = 0;
    static unsigned char bt3_count = 0;
    static unsigned char key_stable = 0;
    static unsigned char key_last = 0;
    static unsigned char key_count = 0;
    static unsigned int bt2_hold_ms = 0;
    static unsigned char bt2_hold_sent = 0;
    unsigned char raw_key;

    if (debounce_state((BT1_MODE == BTN_PRESSED), &bt1_stable, &bt1_last, &bt1_count)) {
        bt1_event = 1;
    }

    if (debounce_state((BT3_ZERO == BTN_PRESSED), &bt3_stable, &bt3_last, &bt3_count)) {
        bt3_event = 1;
    }

    debounce_state((BT2_EDIT == BTN_PRESSED), &bt2_stable, &bt2_last, &bt2_count);
    if (bt2_stable) {
        if (!bt2_hold_sent) {
            bt2_hold_ms += POLL_MS;
            if (bt2_hold_ms >= BT2_HOLD_MS) {
                bt2_hold_event = 1;
                bt2_hold_sent = 1;
            }
        }
    } else {
        if (bt2_hold_ms > 0 && !bt2_hold_sent) {
            bt2_short_event = 1;
        }
        bt2_hold_ms = 0;
        bt2_hold_sent = 0;
    }

    raw_key = scan_keypad_raw();
    if (debounce_state(raw_key, &key_stable, &key_last, &key_count)) {
        if (!keypad_event) {
            keypad_event_value = raw_key;
            keypad_event = 1;
        }
    }
}

void handle_bt1(void)
{
    if (bt1_event) {
        #asm("cli")
        bt1_event = 0;
        #asm("sei")
        if (!edit_mode) {
            display_mode = !display_mode;
            need_redraw = 1;
        }
    }
}

void handle_bt3_zero(void)
{
    if (bt3_event) {
        #asm("cli")
        bt3_event = 0;
        #asm("sei")
        handle_digit(0);
    }
}

void handle_bt2_edit(void)
{
    if (bt2_hold_event) {
        #asm("cli")
        bt2_hold_event = 0;
        bt2_short_event = 0;
        #asm("sei")
        edit_mode = !edit_mode;
        clear_edit_input();
        edit_field = EDIT_HOUR;
        need_redraw = 1;
        return;
    }

    if (bt2_short_event) {
        #asm("cli")
        bt2_short_event = 0;
        #asm("sei")
        if (edit_mode) {
            next_edit_field();
            need_redraw = 1;
        }
    }
}

void timer1_init(void)
{

    TCCR1A = (0<<COM1A1) | (0<<COM1A0) | (0<<COM1B1) | (0<<COM1B0) |
             (0<<COM1C1) | (0<<COM1C0) | (0<<WGM11) | (0<<WGM10);
    TCCR1B = (0<<ICNC1) | (0<<ICES1) | (0<<WGM13) | (1<<WGM12) |
             (1<<CS12) | (0<<CS11) | (0<<CS10);
    TCNT1H = 0x00;
    TCNT1L = 0x00;
    ICR1H = 0x00;
    ICR1L = 0x00;
    OCR1AH = 0x7A;
    OCR1AL = 0x11;
    OCR1BH = 0x00;
    OCR1BL = 0x00;
    OCR1CH = 0x00;
    OCR1CL = 0x00;

    TIMSK = (0<<OCIE2) | (0<<TOIE2) | (0<<TICIE1) | (1<<OCIE1A) |
            (0<<OCIE1B) | (0<<TOIE1) | (0<<OCIE0) | (0<<TOIE0);
    ETIMSK = (0<<TICIE3) | (0<<OCIE3A) | (0<<OCIE3B) | (0<<TOIE3) |
             (0<<OCIE3C) | (0<<OCIE1C);
}

void timer0_init(void)
{
    /*
       Timer0 tao ngat moi gan 5 ms de quet phim.
       F_CPU = 8 MHz, prescaler = 256:
       8,000,000 / 256 = 31,250 Hz.
       OCR0 = 155 -> 156 dem -> 4.992 ms.
    */
    ASSR = 0<<AS0;
    TCCR0 = (0<<WGM00) | (0<<COM01) | (0<<COM00) | (1<<WGM01) |
            (1<<CS02) | (0<<CS01) | (0<<CS00);
    TCNT0 = 0x00;
    OCR0 = 155;
    TIMSK |= (1<<OCIE0);
}

void codewizard_peripheral_init(void)
{
    ASSR = 0<<AS0;
    TCCR0 = (0<<WGM00) | (0<<COM01) | (0<<COM00) | (0<<WGM01) |
            (0<<CS02) | (0<<CS01) | (0<<CS00);
    TCNT0 = 0x00;
    OCR0 = 0x00;

    TCCR2 = (0<<WGM20) | (0<<COM21) | (0<<COM20) | (0<<WGM21) |
            (0<<CS22) | (0<<CS21) | (0<<CS20);
    TCNT2 = 0x00;
    OCR2 = 0x00;

    TCCR3A = (0<<COM3A1) | (0<<COM3A0) | (0<<COM3B1) | (0<<COM3B0) |
             (0<<COM3C1) | (0<<COM3C0) | (0<<WGM31) | (0<<WGM30);
    TCCR3B = (0<<ICNC3) | (0<<ICES3) | (0<<WGM33) | (0<<WGM32) |
             (0<<CS32) | (0<<CS31) | (0<<CS30);
    TCNT3H = 0x00;
    TCNT3L = 0x00;
    ICR3H = 0x00;
    ICR3L = 0x00;
    OCR3AH = 0x00;
    OCR3AL = 0x00;
    OCR3BH = 0x00;
    OCR3BL = 0x00;
    OCR3CH = 0x00;
    OCR3CL = 0x00;

    EICRA = (0<<ISC31) | (0<<ISC30) | (0<<ISC21) | (0<<ISC20) |
            (0<<ISC11) | (0<<ISC10) | (0<<ISC01) | (0<<ISC00);
    EICRB = (0<<ISC71) | (0<<ISC70) | (0<<ISC61) | (0<<ISC60) |
            (0<<ISC51) | (0<<ISC50) | (0<<ISC41) | (0<<ISC40);
    EIMSK = (0<<INT7) | (0<<INT6) | (0<<INT5) | (0<<INT4) |
            (0<<INT3) | (0<<INT2) | (0<<INT1) | (0<<INT0);

    UCSR0B = (0<<RXCIE0) | (0<<TXCIE0) | (0<<UDRIE0) | (0<<RXEN0) |
             (0<<TXEN0) | (0<<UCSZ02) | (0<<RXB80) | (0<<TXB80);
    UCSR1B = (0<<RXCIE1) | (0<<TXCIE1) | (0<<UDRIE1) | (0<<RXEN1) |
             (0<<TXEN1) | (0<<UCSZ12) | (0<<RXB81) | (0<<TXB81);

    ACSR = (1<<ACD) | (0<<ACBG) | (0<<ACO) | (0<<ACI) |
           (0<<ACIE) | (0<<ACIC) | (0<<ACIS1) | (0<<ACIS0);
    SFIOR = (0<<ACME);

    ADCSRA = (0<<ADEN) | (0<<ADSC) | (0<<ADFR) | (0<<ADIF) |
             (0<<ADIE) | (0<<ADPS2) | (0<<ADPS1) | (0<<ADPS0);

    SPCR = (0<<SPIE) | (0<<SPE) | (0<<DORD) | (0<<MSTR) |
           (0<<CPOL) | (0<<CPHA) | (0<<SPR1) | (0<<SPR0);

    TWCR = (0<<TWEA) | (0<<TWSTA) | (0<<TWSTO) | (0<<TWEN) | (0<<TWIE);
}

void io_init(void)
{
    DDRA = (0<<DDA7) | (0<<DDA6) | (0<<DDA5) | (0<<DDA4) |
           (0<<DDA3) | (0<<DDA2) | (0<<DDA1) | (0<<DDA0);
    PORTA = (0<<PORTA7) | (0<<PORTA6) | (0<<PORTA5) | (0<<PORTA4) |
            (0<<PORTA3) | (0<<PORTA2) | (0<<PORTA1) | (0<<PORTA0);

    DDRB = (0<<DDB7) | (0<<DDB6) | (0<<DDB5) | (0<<DDB4) |
           (0<<DDB3) | (0<<DDB2) | (0<<DDB1) | (0<<DDB0);
    PORTB = (0<<PORTB7) | (0<<PORTB6) | (0<<PORTB5) | (0<<PORTB4) |
            (0<<PORTB3) | (0<<PORTB2) | (0<<PORTB1) | (0<<PORTB0);

    DDRC = (0<<DDC7) | (0<<DDC6) | (0<<DDC5) | (0<<DDC4) |
           (0<<DDC3) | (0<<DDC2) | (0<<DDC1) | (0<<DDC0);
    PORTC = (0<<PORTC7) | (0<<PORTC6) | (0<<PORTC5) | (0<<PORTC4) |
            (0<<PORTC3) | (0<<PORTC2) | (0<<PORTC1) | (0<<PORTC0);

    DDRD = (0<<DDD7) | (0<<DDD6) | (0<<DDD5) | (0<<DDD4) |
           (0<<DDD3) | (0<<DDD2) | (0<<DDD1) | (0<<DDD0);
    PORTD = (0<<PORTD7) | (0<<PORTD6) | (0<<PORTD5) | (0<<PORTD4) |
            (0<<PORTD3) | (0<<PORTD2) | (0<<PORTD1) | (0<<PORTD0);

    DDRE = (0<<DDE7) | (0<<DDE6) | (0<<DDE5) | (0<<DDE4) |
           (0<<DDE3) | (0<<DDE2) | (0<<DDE1) | (0<<DDE0);
    PORTE = (0<<PORTE7) | (0<<PORTE6) | (0<<PORTE5) | (0<<PORTE4) |
            (0<<PORTE3) | (0<<PORTE2) | (0<<PORTE1) | (0<<PORTE0);

    DDRF = (0<<DDF7) | (0<<DDF6) | (0<<DDF5) | (0<<DDF4) |
           (0<<DDF3) | (0<<DDF2) | (0<<DDF1) | (0<<DDF0);
    PORTF = (0<<PORTF7) | (0<<PORTF6) | (0<<PORTF5) | (0<<PORTF4) |
            (0<<PORTF3) | (0<<PORTF2) | (0<<PORTF1) | (0<<PORTF0);

    DDRG = (0<<DDG4) | (0<<DDG3) | (0<<DDG2) | (0<<DDG1) | (0<<DDG0);
    PORTG = (0<<PORTG4) | (0<<PORTG3) | (0<<PORTG2) | (0<<PORTG1) | (0<<PORTG0);

    DDRB = 0x00;
    PORTB = 0x0D;

    DDRC = 0x40;
    PORTC = 0x70;

    DDRE = 0x02;
    PORTE = 0x03;

    DDRD = 0x81;
    PORTD = 0x81;
}

void glcd_start(void)
{
    GLCDINIT_t glcd_init_data;

    glcd_init_data.font = font5x7;
    glcd_init_data.temp_coef = 80;
    glcd_init_data.bias = 3;
    glcd_init_data.vlcd = 55;
    glcd_init(&glcd_init_data);
    glcd_clear();
}

void main(void)
{
    unsigned char key;

    io_init();
    codewizard_peripheral_init();
    glcd_start();
    timer1_init();
    timer0_init();

    #asm("sei")

    draw_screen();

    while (1) {
        while (tick_1s) {
            #asm("cli")
            tick_1s--;
            #asm("sei")
            if (!edit_mode) {
                increase_one_second();
            }
            need_redraw = 1;
        }

        handle_bt1();
        handle_bt2_edit();
        handle_bt3_zero();

        if (keypad_event) {
            #asm("cli")
            key = keypad_event_value;
            keypad_event = 0;
            #asm("sei")
            handle_digit(key);
        }

        if (need_redraw) {
            need_redraw = 0;
            draw_screen();
        }
    }
}
